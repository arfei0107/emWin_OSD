; *************************************************************
; *** Scatter-Loading Description File generated by uVision ***
; *************************************************************

LR_ROM1 0x14000000 0x00800000 ; load region size_region
{   
    ER_ROM1 0x14000000 0x00800000   ; load address = execution address
    {
        *.o (RESET, +First)
        *(InRoot$$Sections)
        
        keil_freertos_startup_lpc18xx43xx.o (+RO)
        sysinit.o (+RO)
        fpu_init.o (+RO)
        board_sysinit.o (+RO)
        board.o (+RO)
        
        chip_18xx_43xx.o (+RO)
        clock_18xx_43xx.o (+RO)
        emc_lpc18xx_43xx.o (+RO)
        rgu_18xx_43xx.o
        
        gpio_18xx_43xx.o (+RO)
        scu_lpc18xx_43xx.o (+RO)
        ssp_18xx_43xx.o (+RO)
        uart_18xx_43xx.o (+RO)
        ustdlib.o (+RO)
    }
  
    RW_IRAM1 0x10000000 0x00020000
    {
        main.o
        ring_buffer.o
        ;-------------- C Library ----------------
        *armlib*    (+RO)
        
        ;---------- emWin Library ----------------
        LCD*.o (+RO)
        GUI_*.o (+RO)
        GUICC*.o (+RO)
        GUIAA*.o (+RO)
        GUIDEV*.o (+RO)
        GUIDRV*.o (+RO)
        
        
        
        ;----------- End of emWiny ----------------
        
        .ANY (.text)
        
    }
  
    RW_IRAM2 0x10080000 0x00012000
    {
        ;-------------- FreeRTOS -----------------
        tasks.o (+RO)
        croutine.o (+RO)
        heap_3.o (+RO)
        list.o (+RO)
        queue.o (+RO)
        port.o (+RO)
        freertoscommonhooks.o (+RO)
        ;---------end of FreeRTOS ----------------
        
        .ANY (+RW +ZI)
    }
  
    ARM_LIB_HEAP 0x20000000 EMPTY 0x4000
    {
    }
    
    ARM_LIB_STACK 0x20008000 EMPTY -0x4000
    {
    }
    
    RW_RAM1 0x28000000 UNINIT 0x00900000
    {
        .ANY (VRAM)
    }
    
    RW_RAM2 0x28900000 UNINIT 0x00400000
    {
        guiconf.o (GUI_RAM)
    }
    
    RW_RAM3 0x28D00000 UNINIT 0x01300000
    {
        gui_user_task.o (.text)
        gui_x.o (.text)
        lcdconf.o (.text)
        guiconf.o (.text)
        
        ;---------- emWin Library ----------------
        TEXT*.o (.text)
        GRAPH*.o (.text)
        WM*.o (.text)
        WINDOW*.o (.text)
        BUTTON*.o (.text)
        DIALOG*.o (.text)
        EDIT*.o (.text)
        ICONVIEW*.o (.text)
        TREEVIEW*.o (.text)
        LISTBOX*.o (.text)
        LISTVIEW*.o (.text)
        HEADER*.o (.text)
        FRAMEWIN*.o (.text)
        SLIDER*.o (.text)
        PROGBAR*.o (.text)
        DROPDOWN*.o (.text)
        RADIO*.o (.text)
        SCROLLBAR*.o (.text)
        CHECKBOX*.o (.text)
        MESSAGEBOX*.o (.text)
        WIDGET*.o (.text)
        
        Font*.o (+RO)
        F16B_1.o (+RO)
        F13_1.o (+RO)
        F16B_ASCII.o (+RO)
        F6x8.o (+RO)
        F13_ASCII.o (+RO)
        guidemo.o(+RO)
        guidemo_*.o(+RO)
        
        ;----------- End of emWiny ----------------
        .ANY(.constdata)
        .ANY(.conststring)
        .ANY(+RO)
    }
}
